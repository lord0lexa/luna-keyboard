## boards/shields/luna/Kconfig.defconfig
```kconfig
if SHIELD_LUNA_LEFT

config ZMK_KEYBOARD_NAME
  default "Luna Keyboard"
config ZMK_SPLIT_ROLE_CENTRAL
  default y
endif

if SHIELD_LUNA_LEFT || SHIELD_LUNA_RIGHT

config ZMK_SPLIT
  default y
endif
```

## boards/shields/luna/Kconfig.shield
```kconfig
config SHIELD_LUNA_LEFT
  def_bool $(shields_list_contains,luna_left)

config SHIELD_LUNA_RIGHT
  def_bool $(shields_list_contains,luna_right)
```
