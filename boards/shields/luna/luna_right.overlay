#include "luna.dtsi"

&default_transform {
  col-offset = <6>;
};

&kscan1 {
  col-gpios
      = <&gpio0 24 (GPIO_ACTIVE_HIGH)>
      , <&gpio0 22 (GPIO_ACTIVE_HIGH)> 
      , <&gpio0 20 (GPIO_ACTIVE_HIGH)>
      , <&gpio0 17 (GPIO_ACTIVE_HIGH)>
      , <&gpio0 8 (GPIO_ACTIVE_HIGH)>
      , <&gpio0 6 (GPIO_ACTIVE_HIGH)>
      ;
};

&kscan2  {
  input-gpios = <&gpio0 10 (GPIO_ACTIVE_LOW | GPIO_PULL_UP)>,  // Direct GPIO 1
                <&gpio1 11 (GPIO_ACTIVE_LOW | GPIO_PULL_UP)>;  // Direct GPIO 2
};
